//####################################################################################################################### 
//# 
//# БИБЛИОТЕКА ОБРАБОТКИ НАЖАТИЙ КЛАВИШ 
//# 
//####################################################################################################################### 
  
#include <avr/io.h>
#include "button_lib.h"

//----------------------------------------------------------------------------------------------------------------------- 
//глобальные переменные
volatile uint8_t BtnFlags;                        //регистр флагов нажатых кнопок 
  
  
//----------------------------------------------------------------------------------------------------------------------- 
//функция инициализации портов (вызвать перед использованием библиотеки) 
void BtnInit (void)                              
{    
    BTN_PORT |= ( BTN_LINE2 | BTN_LINE4);//подтяжка кнопок 
} 
  
  
//----------------------------------------------------------------------------------------------------------------------- 
//функция чтения маски нажатых кнопок  
//возвращает маску нажатых кнопок (биты 0-3 - коротк нажат, биты 4-7 - длинн нажат) 
uint8_t BtnGet (void)                               
{    
	asm ("cli");
    uint8_t temp = BtnFlags; 
    BtnFlags = 0; 
	asm ("sei");
    return temp; 
} 
  
  
//----------------------------------------------------------------------------------------------------------------------- 
//функция циклического опроса кнопок (вызывать с частотой 100Гц, например в прерывании) 
void BtnExe (void)                                 
{    
	static uint8_t BtnLockBit;                  //защелка (защита от дребезга) 
	static uint8_t BtnLockCoun;                 //счетчик защелки (защита от дребезга) 
	static uint8_t BtnLongCoun;                 //счетчик длинного нажатия 
	static uint8_t BtnMascLast;                 //запомнить маску нажатой кнопки для анализа после отжатия кнопки 

	uint8_t BtnMask = 0;  
	//if (~BTN_PIN & BTN_LINE1) 	BtnMask = BTN_SHRT1;//формирование маски нажатых кнопок 
	if (~BTN_PIN & BTN_LINE2) 	BtnMask = BTN_SHRT2;
	//if (~BTN_PIN & BTN_LINE3) 	BtnMask = BTN_SHRT3;
	if (~BTN_PIN & BTN_LINE4) 	BtnMask = BTN_SHRT4;

	//основной алгоритм обработки событий кнопки 
	if (BtnMask){                               //клавиша нажата 
		BtnMascLast = BtnMask;                  //запоминаем для использования после отпускания кнопки 

		if (BtnLockCoun < (BTN_LOCK_TIME/10)){ 
			BtnLockCoun++;                      //обработка дребезга 
			return; 
		} 

		BtnLockBit=1;                           //нажатие зафиксировано      
		if (BtnLongCoun >= (BTN_LONG_TIME/10))                                
			return; 
		
		if (++BtnLongCoun >= (BTN_LONG_TIME/10)) 
			BtnFlags |= (BtnMask << 4);         //установка бита длинного нажатия (старшие 4 бита флагов ButtonByte) 
	} 

	else{                                       //клавиша отжата             
		if (BtnLockCoun){                       //обработка дребезга 
			BtnLockCoun --; 
			return; 
		} 

		if (! BtnLockBit)                     	//отжатие зафиксировано 
			return; 

		BtnLockBit =0; 
		if (BtnLongCoun < (BTN_LONG_TIME/10)) 
			BtnFlags |= BtnMascLast;            //установка бита короткого нажатия (младшие 4 бита флагов ButtonByte) 
		
		BtnLongCoun = 0; 
	} 
} 
  
  
//####################################################################################################################### 
//# 
//# THE END! 
//# 
//#######################################################################################################################
